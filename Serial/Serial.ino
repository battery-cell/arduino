#include <MD_MAX72xx.h>
#include <SPI.h>

#define DATA_PIN    5  // GPIO pin for data
#define CLK_PIN     18 // GPIO pin for clock
#define LOAD_PIN    17 // GPIO pin for chip select
#define MAX_DEVICES 4  // Number of 8x8 matrices

// Create an instance of the MD_MAX72XX object
MD_MAX72XX mx = MD_MAX72XX(MD_MAX72XX::FC16_HW, DATA_PIN, CLK_PIN, LOAD_PIN, MAX_DEVICES);

// Define expression patterns
const uint8_t angry[] = {
  0x1f, 0x1b, 0x33, 0x63, 0xc3, 0x83, 0x83, 0x83, 0x83, 0x83, 0x83, 0xc3, 0x7b, 0x3f, 0x0f, 0x07, 0x07, 0x0f, 0x3f, 0x7b, 0xc3, 0x83, 0x83, 0x83, 0x83, 0x83, 0x83, 0xc3, 0x63, 0x33, 0x1b, 0x1f
};

const uint8_t happy[] = {
  0x30, 0x38, 0x18, 0x1c, 0x1c, 0x0e, 0x0e, 0x0e, 0x0e, 0x1e, 0x3c, 0x3c, 0x38, 0x38, 0x38, 0x30, 0x30, 0x38, 0x38, 0x38, 0x3c, 0x3c, 0x1e, 0x0e, 0x0e, 0x0e, 0x0e, 0x1c, 0x1c, 0x18, 0x38, 0x30
};

const uint8_t sad[] = {
0x00, 0x00, 0x00, 0x08, 0x28, 0x64, 0x74, 0x72, 0x7a, 0x79, 0x7d, 0x7c, 0x7e, 0x7e, 0x3c, 0x00, 0x00, 0x3c, 0x7e, 0x7e, 0x7c, 0x7d, 0x79, 0x7a, 0x72, 0x74, 0x64, 0x28, 0x08, 0x00, 0x00, 0x00
};

const uint8_t neutral[] = {
0x00, 0x00, 0x18, 0x3c, 0x7c, 0x7e, 0xfe, 0xfe, 0xfe, 0xfe, 0xfc, 0xf8, 0x78, 0x30, 0x00, 0x00, 0x00, 0x00, 0x30, 0x78, 0xf8, 0xfc, 0xfe, 0xfe, 0xfe, 0xfe, 0x7e, 0x7c, 0x3c, 0x18, 0x00, 0x00
};

const uint8_t surprise[] = {
0x00, 0xdf, 0xdf, 0x00, 0x00, 0xdf, 0xdf, 0x00, 0x00, 0xdf, 0xdf, 0x00, 0x00, 0xdf, 0xdf, 0x00, 0x00, 0xdf, 0xdf, 0x00, 0x00, 0xdf, 0xdf, 0x00, 0x00, 0xdf, 0xdf, 0x00, 0x00, 0xdf, 0xdf, 0x00};
void setup() {
  Serial.begin(9600);  // Start serial communication
  mx.begin();
  mx.clear();  // Clear the screen at the start
}

void loop() {
  // Check if data is available on the serial port
  if (Serial.available()) {
    String input = Serial.readStringUntil('\n');  // Read the input string
    input.trim();  // Remove any surrounding whitespace

    // Call the appropriate function based on the input string
    if (input == "Angry") {
      displayCustomPattern(angry);
    } else if (input == "Happy") {
      displayCustomPattern(happy);
    } else if (input == "Sad") {
      displayCustomPattern(sad);
    } else if (input == "Neutral") {
      displayCustomPattern(neutral);
    } else if (input == "Surprise") {
      scrollPattern(surprise);
    } else {
      mx.clear();  // Clear if input doesn't match any expression
    }
  }
}

// Function to display custom pattern across all 4 matrices
void displayCustomPattern(const uint8_t pattern[]) {
  for (int i = 0; i < 8; i++) {
    for (int j = 0; j < MAX_DEVICES; j++) {
      mx.setColumn(i + (j * 8), pattern[i + j * 8]);
    }
  }
}

// Function to scroll a pattern from left to right
void scrollPattern(const uint8_t pattern[]) {
  for (int shift = 0; shift < MAX_DEVICES * 8; shift++) {
    mx.clear();
    for (int i = 0; i < MAX_DEVICES * 8; i++) {
      int col = (i + shift) % (MAX_DEVICES * 8);
      mx.setColumn(col, pattern[i]);
    }
    delay(100);
  }
}
